// Copyright 2021 Manna Harbour
// https://github.com/manna-harbour/miryoku

#include "../miryoku/custom_config.h"
#include "../miryoku/mapping/42/corne.h"
#include "../miryoku/miryoku.dtsi"
#include <interfaces/hid-trackball.dtsi>

&hid_trackball_interface {
    automouse-layer = <5>;  // Specify the layer where the auto mouse feature is enabled
    automouse-layer-timeout-ms = <500>;  // Timeout for switching to auto mouse layer
};
